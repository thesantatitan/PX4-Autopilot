## src/modules/custom_att_control/Kconfig
```kconfig
menuconfig MODULES_CUSTOM_ATT_CONTROL
	bool "custom_attitude_control"
	default n
	---help---
		Enable support for custom_attitude_control
```

## src/modules/custom_pos_control/Kconfig
```kconfig
menuconfig MODULES_CUSTOM_POS_CONTROL
	bool "custom_pos_control"
	default n
	---help---
		Enable support for custom_pos_control
```

## src/modules/mc_full_control/Kconfig
```kconfig
menuconfig MODULES_MC_FULL_CONTROL
	bool "mc_full_control"
	default n
	---help---
		Enable support for mc_full_control
```

## src/modules/mc_geom_att_control/Kconfig
```kconfig
menuconfig MODULES_MC_GEOM_ATT_CONTROL
	bool "mc_geom_att_control"
	default n
	---help---
		Enable support for mc_geom_att_control
```
